## boards/nrf54h20dk_nrf54h20_cpuapp.conf
```kconfig
# SPDX-License-Identifier: Apache-2.0
# Copyright 2025 Nordic Semiconductor ASA

CONFIG_PM=y
CONFIG_PM_S2RAM=y
CONFIG_PM_S2RAM_CUSTOM_MARKING=y

CONFIG_BOOT_DELAY=4000

CONFIG_SERIAL=n
CONFIG_PRINTK=n
CONFIG_GPIO=n
CONFIG_LOG=n
CONFIG_CONSOLE=n
CONFIG_UART_CONSOLE=n
```
